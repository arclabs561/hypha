## firmware/hypha_esp_c6_idf/sdkconfig.defaults
```kconfig
# Enable CA certificate bundle for TLS (required for secure HTTPS OTA).
CONFIG_MBEDTLS_CERTIFICATE_BUNDLE=y
CONFIG_MBEDTLS_CERTIFICATE_BUNDLE_DEFAULT_FULL=y

# Bluetooth: NimBLE host only (Bluedroid off), as esp32-nimble requires.
CONFIG_BT_ENABLED=y
CONFIG_BT_BLE_ENABLED=y
CONFIG_BT_BLUEDROID_ENABLED=n
CONFIG_BT_NIMBLE_ENABLED=y
# The scan callback runs on the NimBLE host task and does small heap work
# (map insert, name/mfr strings); default 4-5K stack is tight.
CONFIG_BT_NIMBLE_HOST_TASK_STACK_SIZE=8192

# Main task runs the whole app loop: the OTA check alone puts a 4KB chunk
# buffer on this stack, and the IDF default (3584) guarantees a stack
# protection fault the moment try_ota_update runs (observed on first boot:
# Guru Meditation right after "MQTT client created"). 16K is comfortable
# for HTTP-client + JSON-building depth.
CONFIG_ESP_MAIN_TASK_STACK_SIZE=16384

# Main-task priority: the app loop runs on the main task. At the
# IDF default (1) it starved -- WiFi (23) and the NimBLE host (~22-23) sit far
# above it and a single core is strictly preemptive, so the loop ran every ~9s
# not ~2s (firefly-8s, slow OTA, watchdog). 18 is in the 18-22 band: above the
# LED/BLE app threads and idle, but BELOW the radios so it never chokes WiFi/BLE.
# Safe because the loop is block-and-wake (sleeps 50ms; brief CPU each wake).
CONFIG_ESP_MAIN_TASK_PRIORITY=18

# Don't panic-reboot on the task watchdog: with bursty radio load IDLE can miss
# its window transiently; we want a logged warning, not a reset loop.
CONFIG_ESP_TASK_WDT_PANIC=n

# WiFi/BLE coexistence on the C6's single radio is managed by ESP-IDF:
# BLE scan windows yield to WiFi, so some adverts are missed (acceptable
# for seconds-resolution presence).
CONFIG_ESP_COEX_SW_COEXIST_ENABLE=y

# Partition table: EspOta needs dual app slots. The custom table lives in
# partitions_ota.csv but is NOT wired via CONFIG_PARTITION_TABLE_* here --
# esp-idf-sys resolves that path against its generated CMake project, not
# this crate dir. Pass it at flash time instead:
#   cargo espflash flash --release --partition-table partitions_ota.csv
```
